## tc32/dts/bindings/behaviors/zmk,behavior-backlight-rgb.yaml
```yaml
# SPDX-License-Identifier: GPL-3.0-or-later

description: |
  ZMK's RGB commands (dt-bindings/zmk/rgb.h: RGB_TOG, RGB_HUI, RGB_BRI, ...)
  for the "zmk,backlight-effects" (src/behavior_backlight_rgb.c: hue
  steps the preset colours, saturation the white mixed in, brightness the
  levels, speed the speeds).

compatible: "zmk,behavior-backlight-rgb"

include: two_param.yaml
```

## tc32/dts/bindings/behaviors/zmk,behavior-link-mode.yaml
```yaml
# SPDX-License-Identifier: GPL-3.0-or-later

description: |
  On a board without a mode switch (CONFIG_TLSR_BLE_MODE_FROM_POWER_IN):
  choose the link, 0 USB, 1 BLE or 2 the 2.4G link (CONFIG_TLSR_P24), kept
  with the BLE profiles; running another link, the chip reboots into the
  chosen one (src/behavior_link_mode.c). USB needs the cable's power: chosen
  without it, the key is ignored.

compatible: "zmk,behavior-link-mode"

include: one_param.yaml
```

## tc32/dts/bindings/behaviors/zmk,behavior-p24-pair.yaml
```yaml
# SPDX-License-Identifier: GPL-3.0-or-later

description: |
  Pair the proprietary 2.4G link with a dongle again (CONFIG_TLSR_P24) once
  the key has been held for hold-ms. It does nothing outside the mode
  switch's 2.4G position.

compatible: "zmk,behavior-p24-pair"

include: zero_param.yaml

properties:
  hold-ms:
    type: int
    default: 3000
```

## tc32/dts/bindings/behaviors/zmk,behavior-prev-firmware.yaml
```yaml
# SPDX-License-Identifier: GPL-3.0-or-later

description: |
  Go back to the firmware image in the other flash slot (the stock firmware
  after the first install) and reboot, when the key is held for hold-ms. It
  does nothing when the other slot holds no valid image.

compatible: "zmk,behavior-prev-firmware"

include: zero_param.yaml

properties:
  hold-ms:
    type: int
    default: 3000
```

## tc32/dts/bindings/behaviors/zmk,behavior-status-display.yaml
```yaml
# SPDX-License-Identifier: GPL-3.0-or-later

description: |
  Show the keyboard's state on its LEDs for a few seconds
  (CONFIG_TLSR_STATUS_DISPLAY): the battery, the CPU left over, the link
  modes and the Bluetooth profiles.

compatible: "zmk,behavior-status-display"

include: zero_param.yaml
```

## tc32/dts/bindings/behaviors/zmk,behavior-usb-request.yaml
```yaml
# SPDX-License-Identifier: GPL-3.0-or-later

description: |
  Bring USB up in a position of the mode switch that has none at boot
  (CONFIG_TLSR_USB_ON_REQUEST), until the power goes: for the host tools
  over the cable in the BT and 2.4G positions. No key is typed over it.

compatible: "zmk,behavior-usb-request"

include: zero_param.yaml
```

## tc32/dts/bindings/behaviors/zmk,behavior-usjis.yaml
```yaml
# SPDX-License-Identifier: GPL-3.0-or-later

description: |
  US-JIS substitution mode (src/usjis.c): USJIS_TOG, USJIS_ON or USJIS_OFF
  on the press. Nothing is sent to the host.

compatible: "zmk,behavior-usjis"

include: one_param.yaml
```

## tc32/dts/bindings/kscan/cidoo,led-key-matrix.yaml
```yaml
# SPDX-License-Identifier: GPL-3.0-or-later

description: |
  Key matrix of a TLSR8278 keyboard whose matrix columns also switch the
  columns of an RGB LED matrix (src/led_key_matrix.c; the Cidoo V21's
  wiring). Each column switches the anodes of its
  LEDs through a PNP transistor: a column driven low lights its LEDs, one
  driven high leaves them dark. Each row's red, green and blue lines are PWM
  outputs (high: on). The matrix has diodes from the columns to the rows,
  and the rows read high through their pull-downs when a key connects them
  to a column driven high.

  Timer1 interrupts every 500 us. Each of the first slots lights one column
  (all columns high, the row lines' PWM compare values for that column, the
  PWM on, that column low); the last slot scans the keys with the PWM off.
  At most one column is low while any PWM output runs. With nothing to light
  the timer runs the key scan only, at the same period.

  The column and row GPIO flags must be GPIO_ACTIVE_HIGH: the driver drives
  and reads the physical levels this description gives.

compatible: "cidoo,led-key-matrix"

include: kscan.yaml

properties:
  col-gpios:
    type: phandle-array
    required: true
    description: The columns, in matrix column order
  row-gpios:
    type: phandle-array
    required: true
    description: The rows, in matrix row order, each with its pull-down
  debounce-press-ms:
    type: int
    default: 0
    description: |
      A press counts once the key has read pressed for this long (ZMK's
      debouncer; each scan counts as 6.5 ms). 0 counts it at the first scan
      that sees it.
  debounce-release-ms:
    type: int
    default: 5
    description: |
      A release counts once the key has read released for this long. 5 (as
      ZMK's matrix default) counts it at the second scan in a row that sees
      it released.
  pwm-gpios:
    type: phandle-array
    required: true
    description: |
      The pins of PWM0 to PWM5, in channel order.
  pwm-mux:
    type: array
    required: true
    description: |
      For each pin of pwm-gpios, the pad function value that selects its PWM
      channel (DS-TLSR8278 Table 7-1: PA2-PA4 2, PB0-PB2 0).
  rgb-channels:
    type: array
    required: true
    description: |
      For each row, the PWM channels of its red, green and blue lines (three
      per row).
```

## tc32/dts/bindings/led_strip/cidoo,led-key-matrix-backlight.yaml
```yaml
# SPDX-License-Identifier: GPL-3.0-or-later

description: |
  The RGB backlight of a "cidoo,led-key-matrix" as an LED strip (ZMK's
  underglow). Pixel n of the strip lights the LED positions that
  led-pixels gives it.

compatible: "cidoo,led-key-matrix-backlight"

properties:
  chain-length:
    type: int
    required: true
    description: Pixels in the strip
  led-pixels:
    type: uint8-array
    required: true
    description: |
      For each LED position of the matrix (row * columns + column), the
      strip pixel it shows, or 0xff where there is no LED. Two positions may
      show the same pixel (an LED position under the other half of a 2u key).
```

## tc32/dts/bindings/misc/cidoo,battery.yaml
```yaml
# SPDX-License-Identifier: GPL-3.0-or-later

description: |
  The Cidoo keyboards' battery, measured by the BLE stack (src/ble/ble_battery.c,
  src/battery_adc.c): the SAR ADC on one input against ground, eight
  samples through DFIFO2, the middle four averaged, millivolts on the board's
  scale ((raw * 590 >> 9) + 71), the percentage between the empty and full
  points below, and the level kept by rules for on battery, charging and
  charge complete.

compatible: "cidoo,battery"

properties:
  adc-input:
    type: int
    required: true
    description: |
      The ADC's positive input, as analog 0xeb bits 7:4 take it (B87 SDK
      ADC_InputPchTypeDef; the V21: 4, B3P, the pin PB3).

  full-millivolt:
    type: int
    required: true
    description: |
      The 100 % point, in the board's millivolt scale (the V21: 2823).

  empty-millivolt:
    type: int
    required: true
    description: |
      The 0 % point, in the board's millivolt scale (the V21: 2109).

  power-gpios:
    type: phandle-array
    required: true
    description: |
      Active while external power is in (the V21: PD7 high, input, no pull).

  charging-gpios:
    type: phandle-array
    required: true
    description: |
      Active while charging, inactive once the charge is complete, read only
      with power in (the V21: PD6 high, input, 10 kOhm pull-up).
```

## tc32/dts/bindings/misc/cidoo,mode-switch.yaml
```yaml
# SPDX-License-Identifier: GPL-3.0-or-later

description: |
  The Cidoo keyboards' three-way mode switch (wired, BT, 2.4G), read once by
  the BLE stack (src/ble/ble.c) as follows: the two position pins as inputs with their pull-ups, read three times, then left
  with input, output and pull off. A position pin reads active in its own
  position; both inactive is the wired position.

compatible: "cidoo,mode-switch"

properties:
  ble-gpios:
    type: phandle-array
    required: true
    description: |
      Active in the BT position (V21: PC4 low; V75 Pro: PA0 low), with its
      pull-up in the flags (GPIO_ACTIVE_LOW | GPIO_PULL_UP).

  rf24-gpios:
    type: phandle-array
    required: true
    description: |
      Active in the 2.4G position (both boards: PB6 low), flags as ble-gpios.

  common-gpios:
    type: phandle-array
    description: |
      A pin the switch's common contact sits on, driven low only while the
      switch is read; its level, output enable and pad function are then put
      back as they were (V75 Pro: PA7, the SWS pin). None on the V21, whose
      common contact is ground.
```

## tc32/dts/bindings/misc/zmk,backlight-effects.yaml
```yaml
# SPDX-License-Identifier: GPL-3.0-or-later

description: |
  Backlight effects for the Cidoo V21 (src/led_key_matrix_effects.c) on an LED
  strip: wave, breathe and light, with a 192-step colour wheel and 46 preset
  colours, ten brightness levels and five speeds. The keymap drives them through a
  "zmk,behavior-backlight-rgb".

compatible: "zmk,backlight-effects"

properties:
  led-strip:
    type: phandle
    required: true
    description: The strip whose pixels the effects light
  grid:
    type: uint8-array
    required: true
    description: |
      The six rows of the LED grid, top row first, four pixels
      each, 0xff where a row has fewer. The wave and breathe colour them
      row by row.
  rings:
    type: uint8-array
    required: true
    description: |
      Four rings of pixels around a centre key, the centre first, each the
      same length, padded with 0xff. The light effect fills them outwards.
  num-lock-pixel:
    type: int
    description: |
      The pixel that shows the host's Num Lock (bit 0 of the keyboard LED
      output report, with ZMK_HID_INDICATORS): full white over the effect
      while the backlight is on, whatever the brightness level.
```

## tc32/dts/bindings/sensor/cidoo,detent-encoder.yaml
```yaml
# SPDX-License-Identifier: GPL-3.0-or-later

description: |
  Rotary encoder (knob) counted per detent, as on the Cidoo V75 Pro: a
  move starts at a detent (both pins equal), the pin
  that changes first gives the direction, and the move counts when the other
  pin arrives (both pins equal again). A contact that bounces back to the
  start cancels the move. Each move is two pulses, so with steps = 2 x the
  moves per rotation one move reports 360 / (moves per rotation) degrees.

compatible: "cidoo,detent-encoder"

properties:
  a-gpios:
    type: phandle-array
    required: true
    description: The pin whose change first means clockwise (positive)
  b-gpios:
    type: phandle-array
    required: true
    description: The other pin
  steps:
    type: int
    required: true
    description: Pulses in one full rotation (two per detent move)
```

## tc32/tests/usb-sim/Kconfig
```kconfig
# SPDX-License-Identifier: GPL-3.0-or-later

config TLSR_USB_SIM_TEST
	bool "Test the TLSR8278 usb_dc driver (tc32/drivers/usb/device) against a register model"
	depends on ARCH_POSIX
	select USB_DC_TELINK_B87_SIM
	help
	  Adds a model of the Telink TLSR8278 USB device controller registers
	  and a thread that plays the USB host: it enumerates the device and
	  reads interrupt IN reports, then exits with 0 on success.
```

## tc32/tests/usjis/support/Kconfig
```kconfig
# SPDX-License-Identifier: GPL-3.0-or-later

config KB1_TEST_BOOT_DELAY_MS
    int "Test only: delay the inits between the physical layouts and the keymap (ms)"
    default 0
    help
      boot_delay.c sleeps this long in an init placed just before ZMK's
      keymap.c, as slow inits do on the keyboard (settings read from flash),
      so that a switch held at power-on is reported before the keymap is
      ready.
```

## tc32/tests/usjis/support/dts/bindings/zmk,behavior-test-clear.yaml
```yaml
# SPDX-License-Identifier: GPL-3.0-or-later

description: Test only. Clears the HID reports as an endpoint change does.

compatible: "zmk,behavior-test-clear"

include: zero_param.yaml
```
