/*
 * SPDX-License-Identifier: MIT
 */

/*
 * ZMK's snapshot tests on the TC32 (tlsr8278_generic): the mock key matrix
 * of the native_sim test board (app/boards/native/native_sim/
 * native_sim_zmk_test_mock.dts), which each test's keymap gives its events,
 * and native_sim's GPIO emulator.
 */
#include <dt-bindings/zmk/kscan_mock.h>

/ {
    chosen {
        zmk,kscan = &kscan;
    };

    kscan: kscan_mock {
        compatible = "zmk,kscan-mock";
        rows = <2>;
        columns = <2>;
        exit-after;
    };

    /* native_sim's GPIO emulator, which the backlight tests drive LEDs on. */
    gpio0: gpio_emul {
        status = "okay";
        compatible = "zephyr,gpio-emul";
        rising-edge;
        falling-edge;
        high-level;
        low-level;
        gpio-controller;
        #gpio-cells = <2>;
    };
};
